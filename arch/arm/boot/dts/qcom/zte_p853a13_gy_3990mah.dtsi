
qcom,zte_p853a13_gy_3990mah {
	/* #2833518_ZTE_N9560_3990mAh_averaged_MasterSlave_Feb28th2017*/
	qcom,max-voltage-uv = <4400000>;
	qcom,nom-batt-capacity-mah = <3990>;
	qcom,batt-id-kohm = <0>;
	qcom,battery-beta = <3800>;
	qcom,battery-type = "ZTE_BATTERY_DATA_ID_2";
	qcom,chg-rslow-comp-c1 = <3156316>;
	qcom,chg-rslow-comp-c2 = <5453367>;
	qcom,chg-rs-to-rslow = <374529>;
	qcom,chg-rslow-comp-thr = <0xB5>;
	qcom,checksum = <0x2005>;
	qcom,gui-version = "PMI8950GUI - 2.0.0.16";
	qcom,fg-profile-data = [
		 F1 83 76 7D
		 A2 81 2D 7C
		 59 83 B8 5F
		 D2 81 8E 8C
		 0C 82 1D 9A
		 CB BC 17 C9
		 5C 0F 04 88
		 DC 7D DC 81
		 61 7C 52 83
		 3E 6B 75 73
		 7D 85 3F 82
		 03 9A 50 BD
		 63 CA 59 0D
		 EC 0F A8 60
		 14 70 71 FD
		 51 3F 15 44
		 1E 3A 00 00
		 41 47 9F 30
		 DE 2B 00 00
		 00 00 00 00
		 00 00 00 00
		 AA 63 9C 62
		 43 72 33 8B
		 CF 76 8A 70
		 A3 65 41 81
		 F2 74 45 6A
		 22 66 A1 A8
		 1D F7 59 C8
		 5C A0 71 0C
		 28 00 FF 36
		 F0 11 30 03
		 00 00 00 0C
	];
};
