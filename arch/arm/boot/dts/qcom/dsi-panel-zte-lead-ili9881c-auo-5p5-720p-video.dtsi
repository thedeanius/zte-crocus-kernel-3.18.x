/* Copyright (c) 2012, Code Aurora Forum. All rights reserved.
 *
 * This program is free software; you can redistribute it and/or modify
 * it under the terms of the GNU General Public License version 2 and
 * only version 2 as published by the Free Software Foundation.
 *
 * This program is distributed in the hope that it will be useful,
 * but WITHOUT ANY WARRANTY; without even the implied warranty of
 * MERCHANTABILITY or FITNESS FOR A PARTICULAR PURPOSE.  See the
 * GNU General Public License for more details.
 */

 /*---------------------------------------------------------------------------
 * This file is autogenerated file using gcdb parser. Please do not edit it.
 * Update input XML file to add a new entry or update variable in this file
 * VERSION = "1.0"
 *file name:dsi-panel-zte-lead-nt35521-cpt-5p5-720p-video.h
 *author   :created by tangzhengbo at 20150109
 *when    			   who(by)   			who(from) 			why
 *2015.01.09	       tangzhengbo	  	        hanwenjun		     create
 *---------------------------------------------------------------------------*/
&mdss_mdp {

        dsi_ili9881c_auo_720p_vid: qcom,mdss_dsi_lead_ili9881c_auo_5p5_720p_video{
        	qcom,mdss-dsi-panel-name =  "zteLEAD(ili9881c)auo_720*1280_5.5Inch";  
		qcom,zte-enable-12bit-bl-ctl;//only for this panel!!!!!!!
		qcom,cont-splash-enabled; 		
 		qcom,mdss-dsi-panel-controller = <&mdss_dsi0>;
		qcom,mdss-dsi-panel-type = "dsi_video_mode";
		qcom,mdss-dsi-panel-destination = "display_1";
		qcom,mdss-dsi-panel-framerate = <60>;
		qcom,mdss-dsi-virtual-channel-id = <0>;
		qcom,mdss-dsi-stream = <0>;
		qcom,mdss-pan-physical-height-dimension = <121>;
		qcom,mdss-pan-physical-width-dimension = <68>;
		qcom,mdss-dsi-panel-width = <720>;
		qcom,mdss-dsi-panel-height = <1280>;
	//	qcom,mdss-dsi-h-front-porch = <90>;//mipi clk=392.52,SZQ on 2016-04-14
	//	qcom,mdss-dsi-h-back-porch = <8>;
	//	qcom,mdss-dsi-h-pulse-width =  <8>;//<12>;

		qcom,mdss-dsi-h-front-porch = <40>;//mipi clk=399.2
		qcom,mdss-dsi-h-back-porch = <50>;
		qcom,mdss-dsi-h-pulse-width =  <20>;
	
		qcom,mdss-dsi-h-sync-skew = <0>;
	//	qcom,mdss-dsi-v-front-porch = <20>;//mipi clk=392.52,SZQ on 2016-04-14
	//	qcom,mdss-dsi-v-back-porch = <16>;		
	//	qcom,mdss-dsi-v-pulse-width = <4>;

		qcom,mdss-dsi-v-front-porch = <24>;//mipi clk=399.2
		qcom,mdss-dsi-v-back-porch = <24>;		
		qcom,mdss-dsi-v-pulse-width = <8>;
		
		qcom,mdss-dsi-h-left-border = <0>;
		qcom,mdss-dsi-h-right-border = <0>;
		qcom,mdss-dsi-v-top-border = <0>;
		qcom,mdss-dsi-v-bottom-border = <0>;
		qcom,mdss-dsi-bpp = <24>;
		qcom,mdss-dsi-color-order = <0>;
		qcom,mdss-dsi-underflow-color = <0xff>;
		qcom,mdss-dsi-border-color = <0>;
		qcom,mdss-dsi-h-sync-pulse = <0>;
		qcom,mdss-dsi-traffic-mode = <1>;		
		qcom,mdss-dsi-lane-map = "lane_map_0123";
		qcom,mdss-dsi-bllp-eof-power-mode;
		qcom,mdss-dsi-bllp-power-mode;
		qcom,suspend-ulps-enabled;
		qcom,mdss-dsi-lane-0-state;
		qcom,mdss-dsi-lane-1-state;
		qcom,mdss-dsi-lane-2-state;
		qcom,mdss-dsi-lane-3-state;
		qcom,mdss-dsi-lp11-init;
		//qcom,mdss-dsi-panel-timings =[76 18 10 00 3c 3e 14 1c 12 03 04 a0];//392.5MHz
		qcom,mdss-dsi-panel-timings =[76 18 10 00 3c 40 14 5a 12 03 04 a0];//399.2MHz,1c->5a,FAE suggested
		qcom,mdss-dsi-t-clk-post = <0x04>;
		qcom,mdss-dsi-t-clk-pre = <0x19>;
		qcom,mdss-dsi-bl-min-level = <1>;
		qcom,mdss-dsi-bl-max-level = <255>;
		qcom,mdss-dsi-dma-trigger = <0x04>;
		qcom,mdss-dsi-mdp-trigger = <0x0>;
		qcom,mdss-dsi-bl-pmic-control-type = "bl_ctrl_dcs";
		//qcom,mdss-dsi-bl-cmd-gpio = <&msmgpio 33 0>;
		qcom,mdss-dsi-reset-sequence = <1 5>, <0 5>, <1 20>;
                qcom,mdss-dsi-on-command= [
39 01 00 00 00 00 04 FF 98 81 03 
//GIP_1
39 01 00 00 00 00 02 01 08 
39 01 00 00 00 00 02 02 00 
39 01 00 00 00 00 02 03 73 
39 01 00 00 00 00 02 04 73 
39 01 00 00 00 00 02 05 14 
39 01 00 00 00 00 02 06 06 
39 01 00 00 00 00 02 07 02 
39 01 00 00 00 00 02 08 05 
39 01 00 00 00 00 02 09 14 
39 01 00 00 00 00 02 0a 14 
39 01 00 00 00 00 02 0b 00 
39 01 00 00 00 00 02 0c 14 
39 01 00 00 00 00 02 0d 14 
39 01 00 00 00 00 02 0e 00 
39 01 00 00 00 00 02 0f 0C 

39 01 00 00 00 00 02 10 0C 
39 01 00 00 00 00 02 11 0C 
39 01 00 00 00 00 02 12 0C 
39 01 00 00 00 00 02 13 14 
39 01 00 00 00 00 02 14 0C 
39 01 00 00 00 00 02 15 00 
39 01 00 00 00 00 02 16 00 
39 01 00 00 00 00 02 17 00 
39 01 00 00 00 00 02 18 00 
39 01 00 00 00 00 02 19 00 
39 01 00 00 00 00 02 1a 00 
39 01 00 00 00 00 02 1b 00 
39 01 00 00 00 00 02 1c 00 
39 01 00 00 00 00 02 1d 00 
39 01 00 00 00 00 02 1e C8 
39 01 00 00 00 00 02 1f 80 

39 01 00 00 00 00 02 20 02 
39 01 00 00 00 00 02 21 00 
39 01 00 00 00 00 02 22 02 
39 01 00 00 00 00 02 23 00 
39 01 00 00 00 00 02 24 00   
39 01 00 00 00 00 02 25 00    
39 01 00 00 00 00 02 26 00 
39 01 00 00 00 00 02 27 00 
39 01 00 00 00 00 02 28 FB 
39 01 00 00 00 00 02 29 43 
39 01 00 00 00 00 02 2a 00 
39 01 00 00 00 00 02 2b 00 
39 01 00 00 00 00 02 2c 07 
39 01 00 00 00 00 02 2d 07 
39 01 00 00 00 00 02 2e FF 
39 01 00 00 00 00 02 2f FF 

39 01 00 00 00 00 02 30 11 
39 01 00 00 00 00 02 31 00 
39 01 00 00 00 00 02 32 00 
39 01 00 00 00 00 02 33 00 
39 01 00 00 00 00 02 34 84 
39 01 00 00 00 00 02 35 80 
39 01 00 00 00 00 02 36 07 
39 01 00 00 00 00 02 37 00 
39 01 00 00 00 00 02 38 00 
39 01 00 00 00 00 02 39 00 
39 01 00 00 00 00 02 3a 00  
39 01 00 00 00 00 02 3b 00 
39 01 00 00 00 00 02 3c 00 
39 01 00 00 00 00 02 3d 00 
39 01 00 00 00 00 02 3e 00 
39 01 00 00 00 00 02 3f 00 

39 01 00 00 00 00 02 40 00 
39 01 00 00 00 00 02 41 88 
39 01 00 00 00 00 02 42 00 
39 01 00 00 00 00 02 43 80 
39 01 00 00 00 00 02 44 08                                                                
//GIP_2                         
39 01 00 00 00 00 02 50 01 
39 01 00 00 00 00 02 51 23 
39 01 00 00 00 00 02 52 45 
39 01 00 00 00 00 02 53 67 
39 01 00 00 00 00 02 54 89 
39 01 00 00 00 00 02 55 ab 
39 01 00 00 00 00 02 56 01 
39 01 00 00 00 00 02 57 23 
39 01 00 00 00 00 02 58 45 
39 01 00 00 00 00 02 59 67 
39 01 00 00 00 00 02 5a 89 
39 01 00 00 00 00 02 5b ab 
39 01 00 00 00 00 02 5c cd 
39 01 00 00 00 00 02 5d ef                                
//GIP_3                         
39 01 00 00 00 00 02 5e 10 
39 01 00 00 00 00 02 5f 02 
39 01 00 00 00 00 02 60 08 
39 01 00 00 00 00 02 61 09 
39 01 00 00 00 00 02 62 10 
39 01 00 00 00 00 02 63 12 
39 01 00 00 00 00 02 64 11 
39 01 00 00 00 00 02 65 13 
39 01 00 00 00 00 02 66 0C 
39 01 00 00 00 00 02 67 02 
39 01 00 00 00 00 02 68 02 
39 01 00 00 00 00 02 69 02 
39 01 00 00 00 00 02 6a 02 
39 01 00 00 00 00 02 6b 02 
39 01 00 00 00 00 02 6c 0E 
39 01 00 00 00 00 02 6d 0D 
39 01 00 00 00 00 02 6e 0F 
39 01 00 00 00 00 02 6f 02 

39 01 00 00 00 00 02 70 02 
39 01 00 00 00 00 02 71 06 
39 01 00 00 00 00 02 72 07 
39 01 00 00 00 00 02 73 02 
39 01 00 00 00 00 02 74 02 
39 01 00 00 00 00 02 75 02 
39 01 00 00 00 00 02 76 07 
39 01 00 00 00 00 02 77 06 
39 01 00 00 00 00 02 78 11 
39 01 00 00 00 00 02 79 13 
39 01 00 00 00 00 02 7a 10 
39 01 00 00 00 00 02 7b 12 
39 01 00 00 00 00 02 7c 0F 
39 01 00 00 00 00 02 7d 02 
39 01 00 00 00 00 02 7e 02 
39 01 00 00 00 00 02 7f 02 

39 01 00 00 00 00 02 80 02 
39 01 00 00 00 00 02 81 02 
39 01 00 00 00 00 02 82 0D 
39 01 00 00 00 00 02 83 0E 
39 01 00 00 00 00 02 84 0C 
39 01 00 00 00 00 02 85 02 
39 01 00 00 00 00 02 86 02 
39 01 00 00 00 00 02 87 09 
39 01 00 00 00 00 02 88 08 
39 01 00 00 00 00 02 89 02 
39 01 00 00 00 00 02 8A 02 
//CMD_Page 4                    
39 01 00 00 00 00 04 FF 98 81 04 
39 01 00 00 00 00 02 6C 15 
39 01 00 00 00 00 02 6E 2D                //di_pwr_reg=0 VGH clamp 15V
39 01 00 00 00 00 02 6F 35                // reg vcl + VGH pumping ratio 3x VGL=-2x
39 01 00 00 00 00 02 3A A4                 //POWER SAVING
39 01 00 00 00 00 02 8D 14                //VGL clamp -10V
39 01 00 00 00 00 02 87 BA                //ESD
39 01 00 00 00 00 02 26 76             
39 01 00 00 00 00 02 B2 D1 
39 01 00 00 00 00 02 B5 06                                
//CMD_Page 1                     
39 01 00 00 00 00 04 FF 98 81 01 
39 01 00 00 00 00 02 22 0A 		//BGR SS
39 01 00 00 00 00 02 31 0B 		//Z column inversion 
39 01 00 00 00 00 02 53 5F 		//VCOM1 
39 01 00 00 00 00 02 55 5F 		//VCOM2

39 01 00 00 00 00 02 50 96          // A7->96,VREG1OUT=4.7V->4.5V
39 01 00 00 00 00 02 51 96          // 9E->96,VREG2OUT=-4.7V->-4.5V
39 01 00 00 00 00 02 60 14          //SDT  
39 01 00 00 00 00 02 61 00          //CRT
39 01 00 00 00 00 02 62 19          //EQT
39 01 00 00 00 00 02 63 10           //PCT

39 01 00 00 00 00 02 A0 00 		//VP255	Gamma P
39 01 00 00 00 00 02 A1 0F                //VP251        
39 01 00 00 00 00 02 A2 1F                //VP247        
39 01 00 00 00 00 02 A3 11                //VP243        
39 01 00 00 00 00 02 A4 15                //VP239        
39 01 00 00 00 00 02 A5 27                //VP231        
39 01 00 00 00 00 02 A6 1D                //VP219        
39 01 00 00 00 00 02 A7 1D                //VP203        
39 01 00 00 00 00 02 A8 7F                //VP175        
39 01 00 00 00 00 02 A9 1D                //VP144        
39 01 00 00 00 00 02 AA 2A                //VP111        
39 01 00 00 00 00 02 AB 7B                //VP80         
39 01 00 00 00 00 02 AC 1B                //VP52         
39 01 00 00 00 00 02 AD 1A                //VP36         
39 01 00 00 00 00 02 AE 4C                //VP24         
39 01 00 00 00 00 02 AF 22                //VP16         
39 01 00 00 00 00 02 B0 28                //VP12         
39 01 00 00 00 00 02 B1 57                //VP8          
39 01 00 00 00 00 02 B2 69                //VP4          
39 01 00 00 00 00 02 B3 3F                //VP0          
                                               
39 01 00 00 00 00 02 C0 0A 		//VN255 GAMMA N
39 01 00 00 00 00 02 C1 0F                //VN251        
39 01 00 00 00 00 02 C2 1F                //VN247        
39 01 00 00 00 00 02 C3 11                //VN243        
39 01 00 00 00 00 02 C4 15                //VN239        
39 01 00 00 00 00 02 C5 27                //VN231        
39 01 00 00 00 00 02 C6 1D                //VN219        
39 01 00 00 00 00 02 C7 1D                //VN203        
39 01 00 00 00 00 02 C8 7F                //VN175        
39 01 00 00 00 00 02 C9 1D                //VN144        
39 01 00 00 00 00 02 CA 2A                //VN111        
39 01 00 00 00 00 02 CB 7B                //VN80         
39 01 00 00 00 00 02 CC 1B                //VN52         
39 01 00 00 00 00 02 CD 1A                //VN36         
39 01 00 00 00 00 02 CE 4C                //VN24         
39 01 00 00 00 00 02 CF 22                //VN16         
39 01 00 00 00 00 02 D0 28                //VN12         
39 01 00 00 00 00 02 D1 57                //VN8          
39 01 00 00 00 00 02 D2 69                //VN4          
39 01 00 00 00 00 02 D3 3F                //VN0  
/*
//CMD_Page 0
39 01 00 00 00 00 04 FF 98 81 00 
	
39 01 00 00 00 00 02 35 01 //te on;

39 01 00 00 00 00 04 FF 98 81 02 
	
39 01 00 00 00 00 02 06 20 //30k
39 01 00 00 00 00 02 07 00 //30k
*/

                     39 00 00 00 00 00 04 ff 98 81 02
                     39 00 00 00 00 00 02 06 40                    
                     39 00 00 00 00 00 02 07 04  //25K
		39 00 00 00 00 00 04 ff 98 81 00
                    // 39 00 00 00 00 00 03 51 0f ff                     
                     39 00 00 00 00 00 02 53 2c 
                     39 00 00 00 00 00 02 55 01 
                    
		39 00 00 00 00 00 03 68 05 00        
		05 01 00 00 78 00 02 11 00 
		05 01 00 00 0a 00 02 29 00

			];				
                qcom,mdss-dsi-on-command-state = "dsi_lp_mode";
                qcom,mdss-dsi-off-command = [
                05 01 00 00 00 00 02 28 00
                05 01 00 00 78 00 02 10 00
                15 01 00 00 00 00 02 4f 01];
                qcom,mdss-dsi-off-command-state = "dsi_hs_mode";
        };
};
