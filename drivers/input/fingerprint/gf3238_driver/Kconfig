## drivers/input/fingerprint/gf3238_driver/Kconfig
```kconfig
config FINGERPRINT_GOODIX_GF3238
	tristate "GOODIX GF3238 fingerprint driver"
	default n
```

## drivers/input/fingerprint/goodix/Kconfig
```kconfig
config FINGERPRINT_GOODIX_GF3228
	tristate "Goodix GF3228 fingerprint drvier support"
	default n
```

## drivers/input/fingerprint_gf3208/Kconfig
```kconfig
config FINGERPRINT_GOODIX_GF3208
				tristate "Goodix GF3208 fingerprint drvier support"
				default n
				help
				  Say Y here to enable goodix fingerprint driver support!
```
