/* Copyright (c) 2012, Code Aurora Forum. All rights reserved.
 *
 * This program is free software; you can redistribute it and/or modify
 * it under the terms of the GNU General Public License version 2 and
 * only version 2 as published by the Free Software Foundation.
 *
 * This program is distributed in the hope that it will be useful,
 * but WITHOUT ANY WARRANTY; without even the implied warranty of
 * MERCHANTABILITY or FITNESS FOR A PARTICULAR PURPOSE.  See the
 * GNU General Public License for more details.
 */

 /*---------------------------------------------------------------------------
 * This file is autogenerated file using gcdb parser. Please do not edit it.
 * Update input XML file to add a new entry or update variable in this file
 * VERSION = "1.0"
 *file name:dsi-panel-zte-lead-nt35521sh-auo-5p5-720p-video.h
 *author   :created by tangzhengbo at 20150109
 *when				who(by)				who(from)			why
 *2015.01.09		tangzhengbo			hanwenjun			create
 *---------------------------------------------------------------------------*/
&mdss_mdp {

		dsi_helitech_ili9881c_cpt_5p5_720p_video: qcom,mdss_dsi_helitech_ili9881c_cpt_5p5_720p_video{
			qcom,mdss-dsi-panel-name =  "zteHELITECH(ILI9881C)CPT_720*1280_5.5Inch";
		qcom,zte-enable-12bit-bl-ctl;//only for this panel!!!!!!!
		qcom,cont-splash-enabled;
		qcom,mdss-dsi-panel-controller = <&mdss_dsi0>;
		qcom,mdss-dsi-panel-type = "dsi_video_mode";
		qcom,mdss-dsi-panel-destination = "display_1";
		qcom,mdss-dsi-panel-framerate = <60>;
		qcom,mdss-dsi-virtual-channel-id = <0>;
		qcom,mdss-dsi-stream = <0>;
		qcom,mdss-pan-physical-height-dimension = <121>;
		qcom,mdss-pan-physical-width-dimension = <68>;
		qcom,mdss-dsi-panel-width = <720>;
		qcom,mdss-dsi-panel-height = <1280>;
		qcom,mdss-dsi-h-front-porch = <120>;//mipi clk=389.34M
		qcom,mdss-dsi-h-back-porch = <110>;
		qcom,mdss-dsi-h-pulse-width =  <10>;
		qcom,mdss-dsi-h-sync-skew = <0>;
		qcom,mdss-dsi-v-front-porch = <20>;
		qcom,mdss-dsi-v-back-porch = <18>;
		qcom,mdss-dsi-v-pulse-width = <10>;
		qcom,mdss-dsi-h-left-border = <0>;
		qcom,mdss-dsi-h-right-border = <0>;
		qcom,mdss-dsi-v-top-border = <0>;
		qcom,mdss-dsi-v-bottom-border = <0>;
		qcom,mdss-dsi-bpp = <24>;
		qcom,mdss-dsi-color-order = <0>;
		qcom,mdss-dsi-underflow-color = <0xff>;
		qcom,mdss-dsi-border-color = <0>;
		qcom,mdss-dsi-h-sync-pulse = <0>;
		qcom,mdss-dsi-traffic-mode = <1>;
		qcom,mdss-dsi-lane-map = "lane_map_0123";
		qcom,mdss-dsi-bllp-eof-power-mode;
		qcom,mdss-dsi-bllp-power-mode;
		qcom,suspend-ulps-enabled;
		qcom,mdss-dsi-lane-0-state;
		qcom,mdss-dsi-lane-1-state;
		qcom,mdss-dsi-lane-2-state;
		qcom,mdss-dsi-lane-3-state;
		qcom,mdss-dsi-lp11-init;
		qcom,mdss-dsi-panel-timings =[7B 1E 14 00 44 48 18 22 19 03 04 00];
		qcom,mdss-dsi-t-clk-post = <0x04>;
		qcom,mdss-dsi-t-clk-pre = <0x1B>;
		qcom,mdss-dsi-bl-min-level = <1>;
		qcom,mdss-dsi-bl-max-level = <255>;
		qcom,mdss-dsi-dma-trigger = <0x04>;
		qcom,mdss-dsi-mdp-trigger = <0x0>;
		qcom,mdss-dsi-bl-pmic-control-type = "bl_ctrl_dcs";
		//qcom,mdss-dsi-bl-cmd-gpio = <&msmgpio 33 0>;
		qcom,mdss-dsi-reset-sequence = <1 5>, <0 5>, <1 20>;
				qcom,mdss-dsi-on-command= [
			29 01 00 00 00 00 04 FF 98 81 03
			15 01 00 00 00 00 02 01 00
			15 01 00 00 00 00 02 02 00
			15 01 00 00 00 00 02 03 56
			15 01 00 00 00 00 02 04 13
			15 01 00 00 00 00 02 05 00
			15 01 00 00 00 00 02 06 06
			15 01 00 00 00 00 02 07 01
			15 01 00 00 00 00 02 08 00
			15 01 00 00 00 00 02 09 30
			15 01 00 00 00 00 02 0A 01
			15 01 00 00 00 00 02 0B 00
			15 01 00 00 00 00 02 0C 30
			15 01 00 00 00 00 02 0D 01
			15 01 00 00 00 00 02 0E 00
			15 01 00 00 00 00 02 0F 18
			15 01 00 00 00 00 02 10 18
			15 01 00 00 00 00 02 11 00
			15 01 00 00 00 00 02 12 00
			15 01 00 00 00 00 02 13 00
			15 01 00 00 00 00 02 14 00
			15 01 00 00 00 00 02 15 00
			15 01 00 00 00 00 02 16 00
			15 01 00 00 00 00 02 17 00
			15 01 00 00 00 00 02 18 00
			15 01 00 00 00 00 02 19 00
			15 01 00 00 00 00 02 1A 00
			15 01 00 00 00 00 02 1B 00
			15 01 00 00 00 00 02 1C 00
			15 01 00 00 00 00 02 1D 00
			15 01 00 00 00 00 02 1E 40
			15 01 00 00 00 00 02 1F C0
			15 01 00 00 00 00 02 20 02
			15 01 00 00 00 00 02 21 05
			15 01 00 00 00 00 02 22 02
			15 01 00 00 00 00 02 23 00
			15 01 00 00 00 00 02 24 86
			15 01 00 00 00 00 02 25 85
			15 01 00 00 00 00 02 26 00
			15 01 00 00 00 00 02 27 00
			15 01 00 00 00 00 02 28 3B
			15 01 00 00 00 00 02 29 03
			15 01 00 00 00 00 02 2A 00
			15 01 00 00 00 00 02 2B 00
			15 01 00 00 00 00 02 2C 00
			15 01 00 00 00 00 02 2D 00
			15 01 00 00 00 00 02 2E 00
			15 01 00 00 00 00 02 2F 00
			15 01 00 00 00 00 02 30 00
			15 01 00 00 00 00 02 31 00
			15 01 00 00 00 00 02 32 00
			15 01 00 00 00 00 02 33 00
			15 01 00 00 00 00 02 34 00
			15 01 00 00 00 00 02 35 00
			15 01 00 00 00 00 02 36 00
			15 01 00 00 00 00 02 37 00
			15 01 00 00 00 00 02 38 00
			15 01 00 00 00 00 02 39 00
			15 01 00 00 00 00 02 3A 00
			15 01 00 00 00 00 02 3B 00
			15 01 00 00 00 00 02 3C 00
			15 01 00 00 00 00 02 3D 00
			15 01 00 00 00 00 02 3E 00
			15 01 00 00 00 00 02 3F 00
			15 01 00 00 00 00 02 40 00
			15 01 00 00 00 00 02 41 00
			15 01 00 00 00 00 02 42 00
			15 01 00 00 00 00 02 43 00
			15 01 00 00 00 00 02 44 00
			15 01 00 00 00 00 02 50 01
			15 01 00 00 00 00 02 51 23
			15 01 00 00 00 00 02 52 45
			15 01 00 00 00 00 02 53 67
			15 01 00 00 00 00 02 54 89
			15 01 00 00 00 00 02 55 AB
			15 01 00 00 00 00 02 56 01
			15 01 00 00 00 00 02 57 23
			15 01 00 00 00 00 02 58 45
			15 01 00 00 00 00 02 59 67
			15 01 00 00 00 00 02 5A 89
			15 01 00 00 00 00 02 5B AB
			15 01 00 00 00 00 02 5C CD
			15 01 00 00 00 00 02 5D EF
			15 01 00 00 00 00 02 5E 11
			15 01 00 00 00 00 02 5F 08
			15 01 00 00 00 00 02 60 00
			15 01 00 00 00 00 02 61 01
			15 01 00 00 00 00 02 62 02
			15 01 00 00 00 00 02 63 02
			15 01 00 00 00 00 02 64 0F
			15 01 00 00 00 00 02 65 0E
			15 01 00 00 00 00 02 66 0D
			15 01 00 00 00 00 02 67 0C
			15 01 00 00 00 00 02 68 02
			15 01 00 00 00 00 02 69 02
			15 01 00 00 00 00 02 6A 02
			15 01 00 00 00 00 02 6B 02
			15 01 00 00 00 00 02 6C 02
			15 01 00 00 00 00 02 6D 02
			15 01 00 00 00 00 02 6E 06
			15 01 00 00 00 00 02 6F 02
			15 01 00 00 00 00 02 70 02
			15 01 00 00 00 00 02 71 02
			15 01 00 00 00 00 02 72 02
			15 01 00 00 00 00 02 73 02
			15 01 00 00 00 00 02 74 02
			15 01 00 00 00 00 02 75 06
			15 01 00 00 00 00 02 76 00
			15 01 00 00 00 00 02 77 01
			15 01 00 00 00 00 02 78 02
			15 01 00 00 00 00 02 79 02
			15 01 00 00 00 00 02 7A 0F
			15 01 00 00 00 00 02 7B 0E
			15 01 00 00 00 00 02 7C 0D
			15 01 00 00 00 00 02 7D 0C
			15 01 00 00 00 00 02 7E 02
			15 01 00 00 00 00 02 7F 02
			15 01 00 00 00 00 02 80 02
			15 01 00 00 00 00 02 81 02
			15 01 00 00 00 00 02 82 02
			15 01 00 00 00 00 02 83 02
			15 01 00 00 00 00 02 84 08
			15 01 00 00 00 00 02 85 02
			15 01 00 00 00 00 02 86 02
			15 01 00 00 00 00 02 87 02
			15 01 00 00 00 00 02 88 02
			15 01 00 00 00 00 02 89 02
			15 01 00 00 00 00 02 8A 02

			29 01 00 00 00 00 04 FF 98 81 04

			15 01 00 00 00 00 02 6C 15
			15 01 00 00 00 00 02 6E 2B
			15 01 00 00 00 00 02 6F 33
			15 01 00 00 00 00 02 8D 15
			15 01 00 00 00 00 02 87 BA
			15 01 00 00 00 00 02 26 76
			15 01 00 00 00 00 02 B2 D1
			15 01 00 00 00 00 02 B5 07
			15 01 00 00 00 00 02 35 1F
			15 01 00 00 00 00 02 3A 24

			29 01 00 00 00 00 04 FF 98 81 01

			15 01 00 00 00 00 02 22 0A
			15 01 00 00 00 00 02 31 00
			//29 01 00 00 00 00 02 53 80
			//29 01 00 00 00 00 02 55 7E
			15 01 00 00 00 00 02 50 95
			15 01 00 00 00 00 02 51 95
			15 01 00 00 00 00 02 60 30
			15 01 00 00 00 00 02 61 00
			15 01 00 00 00 00 02 62 19
			15 01 00 00 00 00 02 63 10

			15 01 00 00 00 00 02 A0 08
			15 01 00 00 00 00 02 A1 1C
			15 01 00 00 00 00 02 A2 2A
			15 01 00 00 00 00 02 A3 11
			15 01 00 00 00 00 02 A4 14
			15 01 00 00 00 00 02 A5 27
			15 01 00 00 00 00 02 A6 1C
			15 01 00 00 00 00 02 A7 1D
			15 01 00 00 00 00 02 A8 8A
			15 01 00 00 00 00 02 A9 1C
			15 01 00 00 00 00 02 AA 28
			15 01 00 00 00 00 02 AB 7F
			15 01 00 00 00 00 02 AC 1D
			15 01 00 00 00 00 02 AD 1C
			15 01 00 00 00 00 02 AE 4F
			15 01 00 00 00 00 02 AF 23
			15 01 00 00 00 00 02 B0 28
			15 01 00 00 00 00 02 B1 53
			15 01 00 00 00 00 02 B2 64
			15 01 00 00 00 00 02 B3 39

			15 01 00 00 00 00 02 C0 08
			15 01 00 00 00 00 02 C1 1C
			15 01 00 00 00 00 02 C2 29
			15 01 00 00 00 00 02 C3 11
			15 01 00 00 00 00 02 C4 15
			15 01 00 00 00 00 02 C5 27
			15 01 00 00 00 00 02 C6 1B
			15 01 00 00 00 00 02 C7 1D
			15 01 00 00 00 00 02 C8 89
			15 01 00 00 00 00 02 C9 1C
			15 01 00 00 00 00 02 CA 28
			15 01 00 00 00 00 02 CB 80
			15 01 00 00 00 00 02 CC 1C
			15 01 00 00 00 00 02 CD 1B
			15 01 00 00 00 00 02 CE 4E
			15 01 00 00 00 00 02 CF 23
			15 01 00 00 00 00 02 D0 29
			15 01 00 00 00 00 02 D1 54
			15 01 00 00 00 00 02 D2 64
			15 01 00 00 00 00 02 D3 39

			29 01 00 00 00 00 04 FF 98 81 00
			15 01 00 00 00 00 02 36 00
			39 01 00 00 00 00 02 35 01 //te on;

			39 01 00 00 00 00 04 FF 98 81 02
			39 01 00 00 00 00 02 06 30 //31k
			39 01 00 00 00 00 02 07 01 //31k

			39 00 00 00 00 00 04 ff 98 81 00
			39 00 00 00 00 00 03 51 0f ff
			39 00 00 00 00 00 02 53 2c
			39 00 00 00 00 00 02 55 00

			05 01 00 00 78 00 02 11 00
			05 01 00 00 0a 00 02 29 00

			];
				qcom,mdss-dsi-on-command-state = "dsi_lp_mode";
				qcom,mdss-dsi-off-command = [
				05 01 00 00 00 00 02 28 00
				05 01 00 00 78 00 02 10 00
				15 01 00 00 00 00 02 4f 01];
				qcom,mdss-dsi-off-command-state = "dsi_hs_mode";
		};
};
