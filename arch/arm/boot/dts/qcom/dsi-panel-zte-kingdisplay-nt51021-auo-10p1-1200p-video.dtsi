/* Copyright (c) 2015, The Linux Foundation. All rights reserved.
 *
 * This program is free software; you can redistribute it and/or modify
 * it under the terms of the GNU General Public License version 2 and
 * only version 2 as published by the Free Software Foundation.
 *
 * This program is distributed in the hope that it will be useful,
 * but WITHOUT ANY WARRANTY; without even the implied warranty of
 * MERCHANTABILITY or FITNESS FOR A PARTICULAR PURPOSE.  See the
 * GNU General Public License for more details.
 */

&mdss_mdp {
	dsi_kingdisplay_nt51021_auo_10p1_1200P_video_vid: qcom,mdss_dsi_kingdisplay_nt51021_auo_10p1_1200p_video {
		qcom,mdss-dsi-panel-name = "zteKD(NT51021)AUO_1920*1200_10P1Inch";
		qcom,mdss-dsi-panel-type = "dsi_video_mode";
		qcom,cont-splash-enabled;
		qcom,mdss-pan-physical-width-dimension = <135>;
		qcom,mdss-pan-physical-height-dimension = <217>;
		qcom,mdss-dsi-panel-framerate = <60>;
		qcom,mdss-dsi-virtual-channel-id = <0>;
		qcom,mdss-dsi-stream = <0>;
		qcom,mdss-dsi-panel-width = <1200>;
		qcom,mdss-dsi-panel-height = <1920>;
		qcom,mdss-dsi-h-front-porch = <67>;//bitclk:938M
		qcom,mdss-dsi-h-back-porch = <48>;
		qcom,mdss-dsi-h-pulse-width = <1>;
		qcom,mdss-dsi-h-sync-skew = <0>;
		qcom,mdss-dsi-v-back-porch = <25>;
		qcom,mdss-dsi-v-front-porch = <35>;
		qcom,mdss-dsi-v-pulse-width = <1>;
		qcom,mdss-dsi-h-left-border = <0>;
		qcom,mdss-dsi-h-right-border = <0>;
		qcom,mdss-dsi-v-top-border = <0>;
		qcom,mdss-dsi-v-bottom-border = <0>;
		qcom,mdss-dsi-bpp = <24>;
		qcom,mdss-dsi-underflow-color = <0xff>;
		qcom,mdss-dsi-border-color = <0>;
		qcom,mdss-dsi-h-sync-pulse = <0>;
		qcom,mdss-dsi-traffic-mode = "burst_mode";

		qcom,mdss-dsi-te-pin-select = <1>;
		qcom,mdss-dsi-te-dcs-command = <1>;
		qcom,mdss-dsi-te-check-enable;
		qcom,mdss-dsi-te-using-te-pin;
		qcom,mdss-dsi-wr-mem-start = <0x2c>;
		qcom,mdss-dsi-wr-mem-continue = <0x3c>;

		qcom,mdss-dsi-force-clock-lane-hs;//pan
		//qcom,mdss-dsi-hfp-power-mode;	//add clk and data per line goes to lp11

		qcom,mdss-dsi-bllp-eof-power-mode;
		qcom,mdss-dsi-bllp-power-mode;
		qcom,mdss-dsi-lane-0-state;
		qcom,mdss-dsi-lane-1-state;
		qcom,mdss-dsi-lane-2-state;
		qcom,mdss-dsi-lane-3-state;
		qcom,mdss-dsi-panel-timings = [f2 3a 28 00 6c 70 2c 3e 2e 03 04 00];
		qcom,mdss-dsi-t-clk-post = <0x0E>;
		qcom,mdss-dsi-t-clk-pre = <0x32>;
		qcom,mdss-dsi-panel-timings-phy-v2 = [
			24 20 08 0A 05 03 04 a0
			24 20 08 0A 05 03 04 a0
			24 20 08 0A 05 03 04 a0
			24 20 08 0A 05 03 04 a0
			24 1D 08 0A 05 03 04 a0];
		qcom,mdss-dsi-bl-min-level = <1>;
		qcom,mdss-dsi-bl-max-level = <255>;
		qcom,mdss-dsi-dma-trigger = "trigger_sw";
		qcom,mdss-dsi-mdp-trigger = "none";
		qcom,mdss-dsi-on-command = [
			39 01 00 00 00 00 02 8f a5	//unlock
			39 01 00 00 14 00 02 01 00	//soft reset

			39 01 00 00 00 00 02 8f a5	//unlock

			39 01 00 00 00 00 02 83 BB
			39 01 00 00 00 00 02 84 22
			39 01 00 00 00 00 02 96 00	//pwm min 0,add 0607
			39 01 00 00 00 00 02 94 b9	//pwm 23.4k ~ 31.3k ,add 0517
			39 01 00 00 00 00 02 90 c0	//40 enable cabc ,c0 disable cabc,add 0607
			39 01 00 00 00 00 02 95 10	//diming off,add 0607
			39 01 00 00 00 00 02 91 80	//als diming off ,add 0607

			39 01 00 00 00 00 02 83 00	//get to page0 for BL
			39 01 00 00 00 00 02 84 00	//get to page0 for BL
			39 01 00 00 00 00 02 9f 00	//als duty set 0 ,20160706
			39 01 00 00 00 00 02 8f 00	//lock

			//39 01 00 00 00 00 02 83 00	//bist mode
			//39 01 00 00 00 00 02 84 00
			//39 01 00 00 00 00 02 91 06
		];
		qcom,mdss-dsi-off-command = [
			39 01 00 00 00 00 02 8f a5	//unlock
			05 01 00 00 0a 00 02 28 00
			05 01 00 00 0a 00 02 10 00
			39 01 00 00 00 00 02 8f 00	//unlock
		];
		qcom,mdss-dsi-on-command-state = "dsi_lp_mode";
		qcom,mdss-dsi-off-command-state = "dsi_hs_mode";
		qcom,mdss-dsi-bl-pmic-control-type ="bl_ctrl_dcs";
		qcom,mdss-dsi-reset-sequence = <1 20>, <0 20>, <1 20>;
		//qcom,mdss-dsi-tx-eot-append;
	};
};
