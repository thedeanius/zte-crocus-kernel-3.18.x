/*
 * device tree for zte stollen board
 */

#include "touch-key-backlight-crocus.dtsi"

&int_codec {
	qcom,msm-mbhc-hphl-swh = <1>;
	qcom,msm-mbhc-gnd-swh = <1>;
	qcom,msm-hs-micbias-type = "external";
	qcom,msm-micbias2-ext-cap;
};
&i2c_2 {
	led_aw2013:aw2013@45 {
		aw2013_power-supply = <&pm8937_l10>;
		compatible = "aw2013";
		reg = <0x45>;
		status = "ok";
		aw2013_mode = < 7 >;
	};
};
&led_aw2013 {
	aw2013,led0;
	aw2013,led1;
	aw2013,led2;
};
